## esp-ai-idf-client/main/Kconfig.projbuild
```kconfig
# ==================== 配网方式选择 ====================
choice PROV_TYPE
    prompt "配网方式"
    default PROV_TYPE_BLE

    config PROV_TYPE_BLE
        bool "BLE 蓝牙配网 (NimBLE)"

    config PROV_TYPE_AP
        bool "AP 热点配网"

endchoice

# ==================== 板型选择（由 gen_boards.py 自动生成）====================
rsource "boards/Kconfig.gen"

# ==================== 音频编解码器选择 ====================
# ES8311 等编解码器作为独立配置项，与板型解耦
# 选择后板型定义中的 es8311_cfg 引脚配置生效
choice AUDIO_CODEC
    prompt "音频编解码器"
    default AUDIO_CODEC_NONE

    config AUDIO_CODEC_NONE
        bool "I2S 直连 (INMP441 + MAX98357)"
        help
            不使用外置编解码器，麦克风和扬声器各自通过独立 I2S 总线直连。

    config AUDIO_CODEC_ES8311
        bool "ES8311 (全双工 I2S)"
        help
            使用 ES8311 编解码器，单 I2S 总线全双工驱动 ADC（麦克风）和 DAC（扬声器）。
            需要板型定义中提供 es8311_cfg 引脚配置。

endchoice

# ==================== 环境传感器（environmental_sensor Lua 模块）====================
config LUA_MODULE_ENVIRONMENTAL_SENSOR_BACKEND_DHT
    bool "DHT11/DHT22 温湿度传感器 (GPIO 单总线)"
    default y
    help
        启用 environmental_sensor Lua 模块的 DHT 后端，通过 GPIO 单总线读取
        DHT11/DHT22/AM2301/SI7021 温湿度数据。依赖 esp-dht 驱动组件。

# ==================== 日志级别 ====================
choice LOG_LEVEL_CHOICE
    prompt "日志级别"
    default LOG_LEVEL_PRODUCTION

    config LOG_LEVEL_PRODUCTION
        bool "生产模式 (仅 Warning + Error)"

    config LOG_LEVEL_DEBUG
        bool "调试模式 (全部输出)"

endchoice
```

## esp-ai-idf-client/main/boards/Kconfig.gen
```kconfig
# =============================================================
# Kconfig.gen - 板型选择菜单（自动生成，请勿手动编辑）
# 由 gen_boards.py 扫描 boards/defs/ 目录生成
# =============================================================

choice BOARD_TYPE
    prompt "选择开发板型号"
    default BOARD_BREADBOARD

    # --- ESP32C3 ---
    config BOARD_ESP32C3_SUPERMINI
        bool "[ESP32C3] esp32c3_supermini - ESP32-C3 SuperMini (ES8311 全双工, 无屏)"
        depends on IDF_TARGET_ESP32C3

    # --- ESP32S3 ---
    config BOARD_BREADBOARD
        bool "[ESP32S3] breadboard - ESP32-S3 面包板 (无屏幕)"
        depends on IDF_TARGET_ESP32S3

    config BOARD_BREADBOARD_1_54_LCD
        bool "[ESP32S3] breadboard_1.54_lcd - ESP32-S3 面包板 (1.54寸 LCD)"
        depends on IDF_TARGET_ESP32S3

    config BOARD_BREADBOARD_1_54_LCD_OFFICIAL
        bool "[ESP32S3] breadboard_1.54_lcd_official - ESP32-S3 面包板 (1.54寸 LCD, 官方服务版)"
        depends on IDF_TARGET_ESP32S3

endchoice
```

## esp-ai-idf-client/sdkconfig.defaults
```kconfig
CONFIG_IDF_TARGET="esp32s3"
# CPU 频率 240MHz，提升 GIF 解码和图形渲染性能
CONFIG_ESP_DEFAULT_CPU_FREQ_MHZ_240=y
CONFIG_ESP32S3_DEFAULT_CPU_FREQ_240=y
CONFIG_ESP32S3_SPIRAM_SUPPORT=y
CONFIG_SPIRAM_MODE_OCT=y
CONFIG_SPIRAM_SPEED_80M=y
# LCD 版本需要更多内部 RAM 给 SPI DMA，让更多分配走 PSRAM
# LVGL 9 + WakeNet + SPI DMA 需要预留足够内部 RAM（64KB）
# Lua 5.4 大量小对象分配(<4KB)默认走内部 RAM → 改为 256 字节阈值
CONFIG_SPIRAM_MALLOC_ALWAYSINTERNAL=256
CONFIG_SPIRAM_MALLOC_RESERVE_INTERNAL=131072
CONFIG_SPIRAM_TRY_ALLOCATE_WIFI_LWIP=y
CONFIG_ESPTOOLPY_FLASHSIZE_16MB=y
CONFIG_ESPTOOLPY_FLASHMODE_QIO=y
CONFIG_PARTITION_TABLE_CUSTOM=y
CONFIG_PARTITION_TABLE_CUSTOM_FILENAME="partitions.csv"
CONFIG_BOOTLOADER_APP_ROLLBACK_ENABLE=y
CONFIG_ESP_WIFI_STATIC_RX_BUFFER_NUM=8
# 增大动态缓冲区，应对内部 RAM 碎片化
CONFIG_ESP_WIFI_DYNAMIC_RX_BUFFER_NUM=64
CONFIG_ESP_WIFI_DYNAMIC_TX_BUFFER_NUM=64
# WiFi 驱动 IRAM 优化，防止缓存未命中导致 m f null 错误
CONFIG_ESP_WIFI_IRAM_OPT=y
CONFIG_ESP_WIFI_RX_IRAM_OPT=y
CONFIG_ESP_WIFI_ENABLE_WPA3_SAE=n
CONFIG_LWIP_TCP_SND_BUF_DEFAULT=32768
CONFIG_LWIP_TCP_WND_DEFAULT=32768
CONFIG_WS_BUFFER_SIZE=4096
CONFIG_ESP_WS_CLIENT_SEPARATE_TX_LOCK=y
CONFIG_FREERTOS_HZ=1000
# 看门狗超时 10 秒
CONFIG_ESP_TASK_WDT_TIMEOUT_S=10
CONFIG_LOG_DEFAULT_LEVEL_VERBOSE=y
CONFIG_LOG_MAXIMUM_LEVEL=5
# 默认板型:1.54寸 LCD 普通板(使用配网配置的服务器)
# 官方服务版 esp32s3_breadboard_1.54_lcd_official 可在 menuconfig "选择开发板型号" 中切换
CONFIG_BOARD_ESP32S3_BREADBOARD_1_54_LCD=y
CONFIG_PROV_TYPE_BLE=y
CONFIG_BT_ENABLED=y
CONFIG_BT_BLE_42_FEATURES_SUPPORTED=y
# CONFIG_BT_BLUEDROID_ENABLED is not set
CONFIG_BT_NIMBLE_ENABLED=y
CONFIG_BT_BLE_ENABLED=y
CONFIG_BT_BLE_DYNAMIC_ENV_MEMORY=y
CONFIG_BT_ALLOCATION_FROM_SPIRAM_FIRST=y
CONFIG_BT_BLE_42_ADV_EN=y
CONFIG_BT_GATTC_ENABLE=n
CONFIG_BT_BLE_SMP_ENABLE=n
CONFIG_BT_BLE_VENDOR_HCI_EN=y
CONFIG_BT_CTRL_BLE_MASTER=y
CONFIG_BT_CTRL_BLE_SCAN=n
CONFIG_BT_CTRL_DTM_ENABLE=n
CONFIG_MODEL_IN_FLASH=y
CONFIG_SR_WN_WN9_XIAOMINGTONGXUE_TTS2=y

CONFIG_ESP_MAIN_TASK_STACK_SIZE=10240
CONFIG_ESP_TIMER_TASK_STACK_SIZE=6144
CONFIG_BT_NIMBLE_HOST_TASK_STACK_SIZE=6144

# NimBLE 内存优化：从 PSRAM 分配
CONFIG_BT_NIMBLE_MEM_ALLOC_MODE_EXTERNAL=y
CONFIG_BT_NIMBLE_MAX_BONDS=3
CONFIG_BT_NIMBLE_MAX_CCCDS=1
CONFIG_NIMBLE_MEM_ALLOC_MODE_EXTERNAL=y
CONFIG_NIMBLE_MAX_BONDS=3
CONFIG_NIMBLE_MAX_CCCDS=1

# v6.0 PicolibC 兼容性
CONFIG_LIBC_PICOLIBC_NEWLIB_COMPATIBILITY=y

# ==================== LVGL 9.2 配置====================
# LCD ST7789 要求 RGB565 16-bit 颜色深度
CONFIG_LV_COLOR_DEPTH_16=y
CONFIG_LV_COLOR_16_SWAP=y
# LVGL 使用标准 C malloc/realloc/free，当 SPIRAM_USE_MALLOC=y 时自动走 PSRAM
CONFIG_LV_USE_CLIB_MALLOC=y
CONFIG_LV_USE_CLIB_STRING=y
CONFIG_LV_USE_CLIB_SPRINTF=y
# OS_NONE，由 esp_lvgl_port 自己管理 FreeRTOS 任务
CONFIG_LV_OS_NONE=y
# 单绘制单元（默认值，双绘制单元需要 OS 支持且容易触发看门狗）
CONFIG_LV_DRAW_SW_DRAW_UNIT_CNT=1
# 增大 LVGL 绘图层缓冲区以支持 GIF 解码（从 PSRAM 分配）
CONFIG_LV_DRAW_LAYER_SIMPLE_BUF_SIZE=65536
CONFIG_LV_USE_GIF=y
CONFIG_LV_FONT_MONTSERRAT_14=y
# 48px 大号数字字体（屏保时钟 HH:MM 使用）
CONFIG_LV_FONT_MONTSERRAT_48=y
# 启用符号字体（LV_SYMBOL_* 图标必需）
CONFIG_LV_FONT_UNSCII_16=y
# 仅启用实际使用的色深，减少 blend 分支判断开销
CONFIG_LV_DRAW_SW_SUPPORT_RGB565=y
CONFIG_LV_DRAW_SW_SUPPORT_RGB565A8=y
CONFIG_LV_DRAW_SW_SUPPORT_A8=y
# CONFIG_LV_DRAW_SW_SUPPORT_ARGB8888 is not set
CONFIG_LV_FONT_FMT_TXT_LARGE=y
# 字体使用 lv_font_conv 默认 RLE 压缩生成（约省 1MB+），必须开启本选项才能解码
CONFIG_LV_USE_FONT_COMPRESSED=y
CONFIG_LV_USE_FONT_PLACEHOLDER=y
CONFIG_LV_USE_ANIMIMG=y
# C++ 异常和 RTTI 关闭（减小固件体积）
CONFIG_COMPILER_CXX_EXCEPTIONS=n
CONFIG_COMPILER_CXX_RTTI=n

# SPIFFS 文件系统（供 Lua storage 模块使用）
CONFIG_SPIFFS_CFG_MAX_FILES=5
# 增加可用 socket 数量，避免 HTTP 下载 + WebSocket 时端口耗尽
CONFIG_LWIP_MAX_SOCKETS=16

# 日志级别设为 INFO（关闭 DEBUG/VERBOSE 刷屏日志）
CONFIG_LOG_DEFAULT_LEVEL_INFO=y
CONFIG_LOG_COLORS=y
```
